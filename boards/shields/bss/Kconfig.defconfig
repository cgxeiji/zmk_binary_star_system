## boards/shields/bss/Kconfig.defconfig
```kconfig
if SHIELD_BSS_RIGHT

config ZMK_KEYBOARD_NAME
    default "Binary Star S."

config ZMK_SPLIT_ROLE_CENTRAL
    default y

endif

if SHIELD_BSS_LEFT || SHIELD_BSS_RIGHT

config ZMK_SPLIT
    default y

endif
```

## boards/shields/bss/Kconfig.shield
```kconfig
config SHIELD_BSS_LEFT
    def_bool $(shields_list_contains,bss_left)

config SHIELD_BSS_RIGHT
    def_bool $(shields_list_contains,bss_right)
```

## config/boards/shields/bss/Kconfig.defconfig
```kconfig
if SHIELD_BSS_RIGHT

config ZMK_KEYBOARD_NAME
    default "Binary Star System"

config ZMK_SPLIT_ROLE_CENTRAL
    default y

endif

if SHIELD_BSS_LEFT || SHIELD_BSS_RIGHT

config ZMK_SPLIT
    default y

endif
```

## config/west.yml
```yaml
manifest:
  remotes:
    - name: zmkfirmware
      url-base: https://github.com/zmkfirmware
    - name: cgx
      url-base: https://github.com/cgxeiji
  projects:
    - name: zmk
      remote: zmkfirmware
      revision: main
      import: app/west.yml
    - name: zmk_binary_star_system
      remote: cgx
      revision: master
  self:
    path: config
```
